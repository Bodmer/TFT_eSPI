#include <Arduino.h>
#include <TFT_eSPI.h>
#include <driver/pcnt.h>
#include <driver/dac.h>
#include <driver/gpio.h>
#include <driver/ledc.h>
#include <driver/periph_ctrl.h>
#include <esp_err.h>
#include <esp_intr_alloc.h>
#include <soc/gpio_sig_map.h>
#include <soc/i2s_struct.h>
#include <soc/periph_defs.h>
#include <rom/lldesc.h>

#include <algorithm>

namespace {
constexpr int peakDetectorPin = 34;
constexpr int invertedPeakDetectorPin = 35;
constexpr int gainPotPin = 32;
constexpr int frequencyScalePotPin = 33;
constexpr int frequencyInputPin = 27;
constexpr int adcClockOutputPin = 15;
constexpr int adcClockInputPin = 39;
constexpr int adcDataPins[] = {13, 14, 16, 17, 21, 22, 26, 36};
constexpr uint32_t potentiometerUpdatePeriodMs = 33;
constexpr uint8_t potentiometerAverageCount = 10;
constexpr uint8_t detectorAverageCount = 10;
constexpr float gainSmoothingFactor = 0.1f;
enum class DisplayFrameRateCap : uint32_t {
  Fps10 = 10,
  Fps40 = 40,
};
constexpr DisplayFrameRateCap displayFrameRateCap =
    DisplayFrameRateCap::Fps10;
constexpr uint32_t maximumDisplayFrameRate =
    static_cast<uint32_t>(displayFrameRateCap);
constexpr uint32_t minimumDisplayFrameIntervalUs =
    (1000000UL + maximumDisplayFrameRate - 1) / maximumDisplayFrameRate;
constexpr uint32_t maximumFrequencyWindowUs = 10UL * 1000000UL;
constexpr uint16_t frequencyInputGlitchFilterApbCycles = 80;
constexpr int16_t frequencyCounterLimit = 30000;
constexpr uint16_t backgroundColor = TFT_BLACK;
constexpr int plotLeft = 12;
constexpr int plotTop = 32;
constexpr int plotWidth = 344;
constexpr int plotHeight = 208;
constexpr int horizontalDivisions = 8;
constexpr int verticalDivisions = 4;
constexpr int plotSampleCount = plotWidth-2;
constexpr uint8_t frequencyAveragingWindows = 5;
constexpr float peakRetriggerRatio = 0.95f;
constexpr int panelLeft = 368;
constexpr int panelWidth = 100;
constexpr int panelTop = 10;
constexpr int panelRowHeight = 56;
constexpr size_t adcCaptureSampleCount =
    static_cast<size_t>(plotSampleCount) * 2;
constexpr size_t adcDmaWordCount = adcCaptureSampleCount;
constexpr uint32_t adcClockSourceHz = 80000000UL;
constexpr ledc_mode_t adcClockSpeedMode = LEDC_HIGH_SPEED_MODE;
constexpr ledc_timer_t adcClockTimer = LEDC_TIMER_0;
constexpr ledc_channel_t adcClockChannel = LEDC_CHANNEL_0;

// linearizing the ADC
const float ADC_LUT[4096] = { 0,
  82.0000,86.2000,90.4000,94.6000,97.0000,98.0000,99.4000,100.8000,102.0000,103.0000,104.4000,105.8000,107.0000,108.0000,109.4000,
  110.8000,112.0000,113.0000,114.0000,115.2000,116.4000,117.8000,118.8000,119.8000,121.0000,122.0000,123.0000,124.2000,125.4000,126.8000,
  127.8000,128.8000,130.0000,131.0000,132.2000,133.4000,134.8000,135.8000,137.0000,138.0000,139.0000,140.4000,141.6000,142.8000,143.8000,
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  4065.8000,4066.8000,4067.8000,4068.8000,4069.8000,4070.8000,4071.8000,4072.8000,4073.8000,4074.8000,4075.8000,4076.8000,4077.8000,4078.8000,4079.80
  };


// possible sampling rates i decided on for the external ADC
const int sampling_rates[] = {100,200,300,400,500,600,700,800,900,1000,2000,3000,4000,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9000000,10000000};

// the things i believe should be global
int Sampling_rate = 0;
float peak = 0, valley=0, freq = 0, offset = 0, Vpp = 0, Gain;


TFT_eSPI display;
float measuredFrequencyHz = 0.0f;
bool frequencyKnown = false;
bool frequencyOverRange = false;
uint32_t frequencyWindowStartUs = 0;
uint64_t accumulatedPulseCount = 0;
uint64_t accumulatedFrequencyWindowUs = 0;
uint8_t accumulatedFrequencyWindows = 0;
bool accumulatedFrequencyOverRange = false;
uint32_t displayRateWindowStartMs = 0;
uint32_t lastDisplayFrameUs = 0;
uint16_t displayChangeFrames = 0;
float displayChangeRateHz = 0.0f;
bool displayRateReady = false;
uint32_t lastControlUpdateMs = 0;
uint32_t lastPeakRefreshUs = 0;
uint32_t lastValleyRefreshUs = 0;
bool detectorValuesInitialized = false;
bool gainInitialized = false;
float filteredGain = 0.0f;
int lastDacOutput = -1;
String lastMeasurementValues[4];
String lastFooterValues[3];
DMA_ATTR uint32_t adcDmaWords[adcDmaWordCount];
DMA_ATTR lldesc_t adcDmaDescriptor;
uint8_t adcSamples[adcCaptureSampleCount];
TaskHandle_t adcCaptureTaskHandle = nullptr;
volatile int requestedAdcSamplingRate = 0;
volatile bool adcCaptureReady = false;
volatile uint32_t adcCaptureSequence = 0;
volatile bool adcCaptureDmaFailed = false;
volatile uint32_t adcCaptureDmaErrorCount = 0;
intr_handle_t i2sInterruptHandle = nullptr;
uint8_t adcClockResolution = 1;

void IRAM_ATTR i2sCaptureInterrupt(void*) {
  const uint32_t interruptStatus = I2S0.int_st.val;
  I2S0.int_clr.val = interruptStatus;
  const bool captureError =
      (interruptStatus & ((1U << 10) | (1U << 13) | (1U << 15))) != 0;
  const bool captureComplete = (interruptStatus & (1U << 9)) != 0;
  if (captureError) {
    adcCaptureDmaFailed = true;
    ++adcCaptureDmaErrorCount;
  }
  if ((captureComplete || captureError) && adcCaptureTaskHandle != nullptr) {
    BaseType_t higherPriorityTaskWoken = pdFALSE;
    vTaskNotifyGiveFromISR(adcCaptureTaskHandle, &higherPriorityTaskWoken);
    if (higherPriorityTaskWoken == pdTRUE) {
      portYIELD_FROM_ISR();
    }
  }
}

void configureAdcClock(uint32_t samplingRate) {
  uint8_t resolution = 1;
  for (uint8_t candidate = 1; candidate <= 13; ++candidate) {
    const double divider =
        static_cast<double>(adcClockSourceHz) /
        (static_cast<double>(samplingRate) * (1U << candidate));
    if (divider >= 1.0 && divider <= 1024.0) {
      resolution = candidate;
    }
  }
  adcClockResolution = resolution;

  ledc_timer_config_t timerConfig = {};
  timerConfig.speed_mode = adcClockSpeedMode;
  timerConfig.duty_resolution =
      static_cast<ledc_timer_bit_t>(adcClockResolution);
  timerConfig.timer_num = adcClockTimer;
  timerConfig.freq_hz = samplingRate;
  timerConfig.clk_cfg = LEDC_USE_APB_CLK;
  ESP_ERROR_CHECK(ledc_timer_config(&timerConfig));

  const uint32_t duty = 1U << (adcClockResolution - 1);
  ledc_channel_config_t channelConfig = {};
  channelConfig.gpio_num = adcClockOutputPin;
  channelConfig.speed_mode = adcClockSpeedMode;
  channelConfig.channel = adcClockChannel;
  channelConfig.intr_type = LEDC_INTR_DISABLE;
  channelConfig.timer_sel = adcClockTimer;
  channelConfig.duty = duty;
  channelConfig.hpoint = 0;
  ESP_ERROR_CHECK(ledc_channel_config(&channelConfig));
}

void configureAdcCapture() {
  periph_module_enable(PERIPH_I2S0_MODULE);
  I2S0.conf.val = 0;
  I2S0.conf2.val = 0;
  I2S0.fifo_conf.val = 0;
  I2S0.conf_chan.val = 0;
  I2S0.sample_rate_conf.val = 0;
  I2S0.timing.val = 0;

  for (uint8_t bit = 0; bit < 8; ++bit) {
    ESP_ERROR_CHECK(gpio_set_direction(
        static_cast<gpio_num_t>(adcDataPins[bit]), GPIO_MODE_INPUT));
    gpio_set_pull_mode(static_cast<gpio_num_t>(adcDataPins[bit]),
                       GPIO_FLOATING);
    gpio_matrix_in(adcDataPins[bit], I2S0I_DATA_IN0_IDX + bit, false);
  }
  ESP_ERROR_CHECK(gpio_set_direction(static_cast<gpio_num_t>(adcClockInputPin),
                                     GPIO_MODE_INPUT));
  gpio_set_pull_mode(static_cast<gpio_num_t>(adcClockInputPin), GPIO_FLOATING);
  gpio_matrix_in(adcClockInputPin, I2S0I_WS_IN_IDX, true);
  gpio_matrix_in(GPIO_MATRIX_CONST_ZERO_INPUT, I2S0I_V_SYNC_IDX, false);
  gpio_matrix_in(GPIO_MATRIX_CONST_ZERO_INPUT, I2S0I_H_SYNC_IDX, false);
  gpio_matrix_in(GPIO_MATRIX_CONST_ONE_INPUT, I2S0I_H_ENABLE_IDX, false);

  I2S0.conf.rx_slave_mod = 1;
  I2S0.conf.rx_msb_shift = 0;
  I2S0.conf.rx_right_first = 0;
  I2S0.conf.rx_mono = 0;
  I2S0.conf2.camera_en = 1;
  I2S0.conf2.lcd_en = 1;
  I2S0.fifo_conf.dscr_en = 1;
  I2S0.fifo_conf.rx_fifo_mod = 3;
  I2S0.fifo_conf.rx_fifo_mod_force_en = 1;
  I2S0.conf_chan.rx_chan_mod = 1;
  I2S0.sample_rate_conf.rx_bits_mod = 0;
  I2S0.timing.rx_dsync_sw = 1;

  adcDmaDescriptor.size = sizeof(adcDmaWords);
  adcDmaDescriptor.length = 0;
  adcDmaDescriptor.sosf = 0;
  adcDmaDescriptor.eof = 1;
  adcDmaDescriptor.owner = 1;
  adcDmaDescriptor.buf = reinterpret_cast<uint8_t*>(adcDmaWords);
  adcDmaDescriptor.qe.stqe_next = nullptr;

  ESP_ERROR_CHECK(esp_intr_alloc(ETS_I2S0_INTR_SOURCE,
                                 ESP_INTR_FLAG_IRAM | ESP_INTR_FLAG_LEVEL1,
                                 i2sCaptureInterrupt, nullptr,
                                 &i2sInterruptHandle));
}

void stopAdcDmaCapture() {
  I2S0.conf.rx_start = 0;
  I2S0.int_ena.in_suc_eof = 0;
  I2S0.in_link.stop = 1;
  I2S0.conf.rx_reset = 1;
  I2S0.conf.rx_reset = 0;
  I2S0.conf.rx_fifo_reset = 1;
  I2S0.conf.rx_fifo_reset = 0;
  I2S0.lc_conf.in_rst = 1;
  I2S0.lc_conf.in_rst = 0;
}

void startAdcDmaCapture() {
  adcDmaDescriptor.length = 0;
  adcDmaDescriptor.owner = 1;
  I2S0.conf.rx_start = 0;
  I2S0.conf.rx_reset = 1;
  I2S0.conf.rx_reset = 0;
  I2S0.conf.rx_fifo_reset = 1;
  I2S0.conf.rx_fifo_reset = 0;
  I2S0.lc_conf.in_rst = 1;
  I2S0.lc_conf.in_rst = 0;
  I2S0.lc_conf.ahbm_fifo_rst = 1;
  I2S0.lc_conf.ahbm_fifo_rst = 0;
  I2S0.lc_conf.ahbm_rst = 1;
  I2S0.lc_conf.ahbm_rst = 0;
  I2S0.int_clr.val = I2S0.int_st.val;
  I2S0.rx_eof_num = adcCaptureSampleCount;
  I2S0.in_link.addr =
      (reinterpret_cast<uint32_t>(&adcDmaDescriptor) & 0xfffff);
  I2S0.in_link.start = 1;
  I2S0.int_ena.in_suc_eof = 1;
  I2S0.conf.rx_start = 1;
}

void adcCaptureTask(void*) {
  int activeSamplingRate = 0;
  for (;;) {
    while (adcCaptureReady) {
      vTaskDelay(pdMS_TO_TICKS(1));
    }

    const int requestedRate = requestedAdcSamplingRate;
    if (requestedRate <= 0) {
      vTaskDelay(pdMS_TO_TICKS(10));
      continue;
    }

    if (requestedRate != activeSamplingRate) {
      stopAdcDmaCapture();
      configureAdcClock(static_cast<uint32_t>(requestedRate));
      activeSamplingRate = requestedRate;
    }

    adcCaptureDmaFailed = false;
    startAdcDmaCapture();
    bool captureCompleted = false;
    while (!captureCompleted) {
      if (ulTaskNotifyTake(pdTRUE, pdMS_TO_TICKS(100)) > 0) {
        if (adcCaptureDmaFailed) {
          stopAdcDmaCapture();
          Serial.printf("I2S DMA capture failed (error count %lu).\n",
                        static_cast<unsigned long>(adcCaptureDmaErrorCount));
          break;
        }
        captureCompleted = true;
        continue;
      }
      if (requestedAdcSamplingRate != activeSamplingRate) {
        stopAdcDmaCapture();
        break;
      }
    }

    if (captureCompleted) {
      stopAdcDmaCapture();
      for (size_t sample = 0; sample < adcCaptureSampleCount; ++sample) {
        adcSamples[sample] = static_cast<uint8_t>(
            255U - ((adcDmaWords[sample] >> 8) & 0xffU));
      }
      ++adcCaptureSequence;
      __sync_synchronize();
      adcCaptureReady = true;
    }
  }
}

void drawMeasurementBox(int row, const char* title, uint16_t color);

void drawPlotGrid() {
  for (int division = 0; division <= horizontalDivisions; ++division) {
    const int x = plotLeft + division * (plotWidth - 1) / horizontalDivisions;
    display.drawFastVLine(x, plotTop, plotHeight, TFT_DARKGREY);
  }
  for (int division = 0; division <= verticalDivisions; ++division) {
    const int y = plotTop + division * (plotHeight - 1) / verticalDivisions;
    display.drawFastHLine(plotLeft, y, plotWidth, TFT_DARKGREY);
  }
  display.drawRect(plotLeft, plotTop, plotWidth, plotHeight, TFT_WHITE);
}

bool drawSignalPlot() {
  if (!frequencyKnown) {
    return false;
  }

  const float targetSample =
      255.0f - ((peak + valley) * 0.5f) * (255.0f / 4095.0f);
  const float triggerTolerance = std::max(
      1.0f, fabsf(peak - valley) * (255.0f / 4095.0f) * 0.05f);
  const size_t lastTriggerStart =
      adcCaptureSampleCount - static_cast<size_t>(plotSampleCount);
  size_t closestStart = 0;
  float closestDistance = 256.0f;
  size_t triggerStart = adcCaptureSampleCount;

  for (size_t sample = 0; sample <= lastTriggerStart; ++sample) {
    const float distance = fabsf(adcSamples[sample] - targetSample);
    if (distance < closestDistance) {
      closestDistance = distance;
      closestStart = sample;
    }
    if (distance <= triggerTolerance) {
      triggerStart = sample;
      break;
    }
  }
  if (triggerStart == adcCaptureSampleCount) {
    triggerStart = closestStart;
  }

  display.fillRect(plotLeft + 1, plotTop + 1, plotWidth - 2, plotHeight - 2,
                   backgroundColor);
  drawPlotGrid();

  int previousX = plotLeft + 1;
  int previousY = plotTop + plotHeight - 2 -
                  (static_cast<int>(adcSamples[triggerStart]) *
                   (plotHeight - 3) /
                   255);
  for (int point = 1; point < plotSampleCount; ++point) {
    const size_t sampleIndex = triggerStart + static_cast<size_t>(point);
    const int x = plotLeft + 1 + point;
    const int y = plotTop + plotHeight - 2 -
                  (static_cast<int>(adcSamples[sampleIndex]) *
                   (plotHeight - 3) /
                   255);
    display.drawLine(previousX, previousY, x, y, TFT_YELLOW);
    previousX = x;
    previousY = y;
  }
  return true;
}

void drawStaticUi() {
  display.setRotation(1);
  display.fillScreen(backgroundColor);
  display.setTextColor(TFT_WHITE, backgroundColor);
  display.drawString("SIGNAL", plotLeft, 8, 2);

  drawPlotGrid();

  drawMeasurementBox(0, "Vpeak-peak", TFT_CYAN);
  drawMeasurementBox(1, "Voffset", TFT_GREEN);
  drawMeasurementBox(2, "Sampling rate", TFT_ORANGE);
  drawMeasurementBox(3, "Frequency", TFT_YELLOW);

  display.drawFastHLine(12, 274, display.width() - 24, TFT_DARKGREY);
}

String formatNumber(float value) {
  const float magnitude = fabsf(value);
  const uint8_t decimals = magnitude >= 100.0f ? 0 : magnitude >= 10.0f ? 1 : 2;
  return String(value, static_cast<unsigned int>(decimals));
}

String formatVoltage(float volts) {
  const float magnitude = fabsf(volts);
  if (magnitude >= 1000.0f) {
    return formatNumber(volts / 1000.0f) + " kV";
  }
  if (magnitude >= 1.0f) {
    return formatNumber(volts) + " V";
  }
  if (magnitude >= 0.001f) {
    return formatNumber(volts * 1000.0f) + " mV";
  }
  return formatNumber(volts * 1000000.0f) + " \xC2\xB5V";
}

String formatFrequency(float hertz) {
  const float magnitude = fabsf(hertz);
  if (magnitude >= 1000000.0f) {
    return formatNumber(hertz / 1000000.0f) + " MHz";
  }
  if (magnitude >= 1000.0f) {
    return formatNumber(hertz / 1000.0f) + " kHz";
  }
  return formatNumber(hertz) + " Hz";
}

String formatSamplingRate(int samplesPerSecond) {
  if (samplesPerSecond >= 1000000) {
    return formatNumber(samplesPerSecond / 1000000.0f) + " MSPS";
  }
  if (samplesPerSecond >= 1000) {
    return formatNumber(samplesPerSecond / 1000.0f) + " kSPS";
  }
  return String(samplesPerSecond) + " SPS";
}

String formatTime(float seconds) {
  if (seconds >= 1.0f) {
    return formatNumber(seconds) + " s";
  }
  if (seconds >= 0.001f) {
    return formatNumber(seconds * 1000.0f) + " ms";
  }
  if (seconds >= 0.000001f) {
    return formatNumber(seconds * 1000000.0f) + " \xC2\xB5s";
  }
  return formatNumber(seconds * 1000000000.0f) + " ns";
}

void drawMeasurementBox(int row, const char* title, uint16_t color) {
  const int y = panelTop + row * panelRowHeight;
  display.drawRect(panelLeft, y, panelWidth, panelRowHeight - 4, color);
  display.setTextColor(color, backgroundColor);
  display.drawString(title, panelLeft + 5, y + 4, 1);
}

bool drawMeasurementValue(int row, const String& value) {
  if (lastMeasurementValues[row] == value) {
    return false;
  }

  const int y = panelTop + row * panelRowHeight;
  display.fillRect(panelLeft + 2, y + 19, panelWidth - 4, 28,
                   backgroundColor);
  display.setTextColor(TFT_WHITE, backgroundColor);
  display.drawCentreString(value, panelLeft + panelWidth / 2, y + 20, 2);
  lastMeasurementValues[row] = value;
  return true;
}

bool drawFooterValue(int index, int x, int width, const String& value) {
  if (lastFooterValues[index] == value) {
    return false;
  }

  display.fillRect(x, 282, width, 24, backgroundColor);
  display.setTextColor(TFT_WHITE, backgroundColor);
  display.drawString(value, x, 283, 2);
  lastFooterValues[index] = value;
  return true;
}

bool drawDashboard() {
  bool changed = false;
  changed |= drawMeasurementValue(0, formatVoltage(Vpp));
  changed |= drawMeasurementValue(1, formatVoltage(offset));
  changed |= drawMeasurementValue(2, formatSamplingRate(Sampling_rate));

  const String frequencyValue = frequencyOverRange
      ? ">" + formatFrequency(measuredFrequencyHz)
      : frequencyKnown ? formatFrequency(measuredFrequencyHz) : "?";
  changed |= drawMeasurementValue(3, frequencyValue);

  const float voltsPerDivision =
      3.3 / Gain / static_cast<float>(verticalDivisions);
  const float timePerDivision =
      (static_cast<float>(plotSampleCount) / Sampling_rate) /
      horizontalDivisions;
  changed |= drawFooterValue(
      0, 12, 126, "V/div " + formatVoltage(voltsPerDivision));
  changed |= drawFooterValue(
      1, 146, 184, "T/div " + formatTime(timePerDivision));
  return changed;
}

void drawDisplayChangeRate() {
  const String rateValue = displayRateReady
      ? "Frame rate: " + formatNumber(displayChangeRateHz) + " fps"
      : "Frame rate: -- fps";
  drawFooterValue(2, 340, 128, rateValue);
}

void configureFrequencyCounter() {
  pcnt_config_t config = {};
  config.pulse_gpio_num = frequencyInputPin;
  config.ctrl_gpio_num = PCNT_PIN_NOT_USED;
  config.lctrl_mode = PCNT_MODE_KEEP;
  config.hctrl_mode = PCNT_MODE_KEEP;
  config.pos_mode = PCNT_COUNT_INC;
  config.neg_mode = PCNT_COUNT_DIS;
  config.counter_h_lim = frequencyCounterLimit;
  config.counter_l_lim = 0;
  config.unit = PCNT_UNIT_0;
  config.channel = PCNT_CHANNEL_0;

  ESP_ERROR_CHECK(pcnt_unit_config(&config));
  ESP_ERROR_CHECK(pcnt_event_enable(PCNT_UNIT_0, PCNT_EVT_H_LIM));
  ESP_ERROR_CHECK(pcnt_set_filter_value(
      PCNT_UNIT_0, frequencyInputGlitchFilterApbCycles));
  ESP_ERROR_CHECK(pcnt_filter_enable(PCNT_UNIT_0));
  ESP_ERROR_CHECK(pcnt_counter_clear(PCNT_UNIT_0));
  ESP_ERROR_CHECK(pcnt_counter_resume(PCNT_UNIT_0));
  frequencyWindowStartUs = micros();
}

void clearFrequencyEstimate() {
  accumulatedPulseCount = 0;
  accumulatedFrequencyWindowUs = 0;
  accumulatedFrequencyWindows = 0;
  accumulatedFrequencyOverRange = false;
  measuredFrequencyHz = 0.0f;
  freq = 0.0f;
  frequencyKnown = false;
  frequencyOverRange = false;
}

void updateFrequencyMeasurement(uint32_t nowUs) {
  if (Sampling_rate <= 0) {
    return;
  }

  const uint64_t requestedWindowUs =
      100ULL * 100ULL * 1000000ULL /
      static_cast<uint32_t>(Sampling_rate);
  const uint32_t targetWindowUs = static_cast<uint32_t>(
      std::min<uint64_t>(requestedWindowUs, maximumFrequencyWindowUs));
  const uint32_t elapsedUs = nowUs - frequencyWindowStartUs;
  if (elapsedUs < targetWindowUs) {
    return;
  }

  ESP_ERROR_CHECK(pcnt_counter_pause(PCNT_UNIT_0));
  int16_t pulseCount = 0;
  uint32_t eventStatus = 0;
  ESP_ERROR_CHECK(pcnt_get_counter_value(PCNT_UNIT_0, &pulseCount));
  ESP_ERROR_CHECK(pcnt_get_event_status(PCNT_UNIT_0, &eventStatus));
  ESP_ERROR_CHECK(pcnt_counter_clear(PCNT_UNIT_0));
  ESP_ERROR_CHECK(pcnt_counter_resume(PCNT_UNIT_0));

  frequencyWindowStartUs = nowUs;
  const bool windowOverRange = (eventStatus & PCNT_EVT_H_LIM) != 0;
  if (pulseCount <= 0 && !windowOverRange) {
    clearFrequencyEstimate();
    return;
  }

  const uint32_t recordWindows =
      std::max<uint32_t>(
          1, (elapsedUs + targetWindowUs - 1) / targetWindowUs);
  const uint32_t measuredPulses =
      windowOverRange ? frequencyCounterLimit : pulseCount;
  const bool sparseSinglePulse =
      measuredPulses == 1 && recordWindows == 1;
  if (!sparseSinglePulse && measuredPulses < 2 * recordWindows) {
    clearFrequencyEstimate();
    return;
  }

  accumulatedPulseCount += measuredPulses;
  accumulatedFrequencyWindowUs += elapsedUs;
  accumulatedFrequencyOverRange |= windowOverRange;
  accumulatedFrequencyWindows +=
      static_cast<uint8_t>(std::min<uint32_t>(
          recordWindows, frequencyAveragingWindows));

  if (accumulatedFrequencyWindows >= frequencyAveragingWindows) {
    measuredFrequencyHz =
        static_cast<float>(accumulatedPulseCount) * 1000000.0f /
        static_cast<float>(accumulatedFrequencyWindowUs);
    freq = measuredFrequencyHz;
    frequencyOverRange = accumulatedFrequencyOverRange;
    frequencyKnown = true;
    accumulatedPulseCount = 0;
    accumulatedFrequencyWindowUs = 0;
    accumulatedFrequencyWindows = 0;
    accumulatedFrequencyOverRange = false;
  }
}

uint32_t peakHoldPeriodUs() {
  const float expectedFrequency = Sampling_rate / 100.0f;
  if (expectedFrequency <= 0.0f) {
    return 1000000UL;
  }
  const float periodUs = 1000000.0f / expectedFrequency;
  return static_cast<uint32_t>(std::max(1.0f, periodUs));
}

void updateHeldExtreme(float sample, float& heldValue,
                       uint32_t& lastRefreshUs, uint32_t nowUs,
                       uint32_t holdPeriodUs) {
  if (!detectorValuesInitialized ||
      sample >= heldValue * peakRetriggerRatio) {
    heldValue = std::max(heldValue, sample);
    lastRefreshUs = nowUs;
  } else if (nowUs - lastRefreshUs >= holdPeriodUs) {
    heldValue = sample;
    lastRefreshUs = nowUs;
  }
}

float readDetectorAverage(int pin) {
  float total = 0.0f;
  for (uint8_t sample = 0; sample < detectorAverageCount; ++sample) {
    total += ADC_LUT[analogRead(pin)];
  }
  return total / detectorAverageCount;
}

void updatePeakDetectors(uint32_t nowUs) {
  const float peakSample = readDetectorAverage(peakDetectorPin);
  const float valleySample = 4095.0f -
                             readDetectorAverage(invertedPeakDetectorPin);
  const uint32_t holdPeriodUs = peakHoldPeriodUs();

  updateHeldExtreme(peakSample, peak, lastPeakRefreshUs, nowUs,
                    holdPeriodUs);
  updateHeldExtreme(valleySample, valley, lastValleyRefreshUs, nowUs,
                    holdPeriodUs);
  detectorValuesInitialized = true;

  offset = -((peak + valley) * 0.00040293f - 1.65f) / Gain;
  Vpp = (peak - valley) * 0.00080586f / Gain;

  const int dacOutput =
      static_cast<int>((peak + valley) * 0.03113553f); 
  if (dacOutput != lastDacOutput) {
    dac_output_voltage(DAC_CHANNEL_1, dacOutput);
    lastDacOutput = dacOutput;
  }
}

void updateControlMeasurements() {
  uint32_t gainAdcTotal = 0;
  uint32_t frequencyAdcTotal = 0;
  for (uint8_t sample = 0; sample < potentiometerAverageCount; ++sample) {
    gainAdcTotal += analogRead(gainPotPin);
    frequencyAdcTotal += analogRead(frequencyScalePotPin);
  }
  const uint16_t gainAdcAverage =
      (gainAdcTotal + potentiometerAverageCount / 2) /
      potentiometerAverageCount;
  const uint16_t frequencyAdcAverage =
      (frequencyAdcTotal + potentiometerAverageCount / 2) /
      potentiometerAverageCount;

  float measuredGain =
      (ADC_LUT[gainAdcAverage] * 1.05 - 122.85) * 0.10776 + 0.03014;
  if (measuredGain <= 0) {
    measuredGain = 0.03014f;
  }
  if (!gainInitialized) {
    filteredGain = measuredGain;
    gainInitialized = true;
  } else {
    filteredGain += gainSmoothingFactor * (measuredGain - filteredGain);
  }
  Gain = filteredGain;
  int sampling_index = int(round(
      (ADC_LUT[frequencyAdcAverage] * 1.05 - 122.85) * 0.010989));
  if (sampling_index < 0) {
    sampling_index = 0;
  } else if (sampling_index > 45) {
    sampling_index = 45;
  }
  Sampling_rate = sampling_rates[sampling_index];
  requestedAdcSamplingRate = Sampling_rate;
}
}  // namespace

void setup() {
  // DAC setup
  dac_output_enable(DAC_CHANNEL_1);    // pin 25
  dac_output_voltage(DAC_CHANNEL_1, 0);

  Serial.begin(115200);
  analogReadResolution(12);
  analogSetPinAttenuation(peakDetectorPin, ADC_11db);
  analogSetPinAttenuation(invertedPeakDetectorPin, ADC_11db);
  analogSetPinAttenuation(gainPotPin, ADC_11db);
  analogSetPinAttenuation(frequencyScalePotPin, ADC_11db);
  pinMode(frequencyInputPin, INPUT);

  display.init();
  drawStaticUi();
  updateControlMeasurements();
  updatePeakDetectors(micros());
  configureFrequencyCounter();
  configureAdcCapture();
  if (xTaskCreatePinnedToCore(adcCaptureTask, "adc_capture", 4096, nullptr, 3,
                              &adcCaptureTaskHandle, 0) != pdPASS) {
    ESP_ERROR_CHECK(ESP_FAIL);
  }
  lastControlUpdateMs = millis();
  drawDashboard();
  displayRateWindowStartMs = millis();
  drawDisplayChangeRate();
  lastDisplayFrameUs = micros();
  Serial.println(
      "Measurement inputs ready: ADC GPIO34/35/32/33; frequency counter GPIO27.");
  Serial.printf(
      "ADC capture ready: 8-bit D11..D4 on GPIO36,26,22,21,17,16,14,13; "
      "clock GPIO15, loopback GPIO39; %u samples per capture.\n",
      static_cast<unsigned>(adcCaptureSampleCount));
}

void loop() {
  const uint32_t nowUs = micros();
  updatePeakDetectors(nowUs);
  updateFrequencyMeasurement(nowUs);

  const uint32_t nowMs = millis();

  if (nowMs - lastControlUpdateMs >= potentiometerUpdatePeriodMs) {
    const int previousSamplingRate = Sampling_rate;
    updateControlMeasurements();
    lastControlUpdateMs = nowMs;
    if (Sampling_rate != previousSamplingRate) {
      ESP_ERROR_CHECK(pcnt_counter_pause(PCNT_UNIT_0));
      ESP_ERROR_CHECK(pcnt_counter_clear(PCNT_UNIT_0));
      ESP_ERROR_CHECK(pcnt_counter_resume(PCNT_UNIT_0));
      frequencyWindowStartUs = micros();
      clearFrequencyEstimate();
    }
  }

  const uint32_t rateWindowElapsedMs = nowMs - displayRateWindowStartMs;
  if (rateWindowElapsedMs >= 1000) {
    displayChangeRateHz =
        displayChangeFrames * (1000.0f / rateWindowElapsedMs);
    displayChangeFrames = 0;
    displayRateWindowStartMs = nowMs;
    displayRateReady = true;
  }

  if (nowUs - lastDisplayFrameUs >= minimumDisplayFrameIntervalUs) {
    lastDisplayFrameUs = nowUs;
    bool frameChanged = drawDashboard();
    if (adcCaptureReady) {
      frameChanged |= drawSignalPlot();
      __sync_synchronize();
      adcCaptureReady = false;
      __sync_synchronize();
    }
    drawDisplayChangeRate();
    if (frameChanged && displayChangeFrames < UINT16_MAX) {
      ++displayChangeFrames;
    }
  }
  taskYIELD();
}
